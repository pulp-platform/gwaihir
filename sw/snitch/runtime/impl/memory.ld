/* Copyright 2025 ETH Zurich and University of Bologna. */
/* Licensed under the Apache License, Version 2.0, see LICENSE for details. */
/* SPDX-License-Identifier: Apache-2.0 */

MEMORY
{
    L3 (rwxa) : ORIGIN = 0x21200000, LENGTH = 0x00200000
}
